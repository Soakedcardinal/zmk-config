## config/west.yml
```yaml
manifest:
  defaults:
    revision: v0.2
  remotes:
    - name: zmkfirmware
      url-base: https://github.com/zmkfirmware
    - name: zmk-keyboard-tightyl
      url-base: https://github.com/Soakedcardinal/zmk-keyboard-tightyl
  projects:
    - name: zmk
      remote: zmkfirmware
      import: app/west.yml
    - name: zmk-keyboard-tightyl
      remote: zmk-keyboard-tightyl
      revision: main
  self:
    path: config
```
